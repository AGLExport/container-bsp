## meta-container-bsp-guest/conf/layer.conf
```bitbake
# We have a conf and classes directory, add to BBPATH
BBPATH =. "${LAYERDIR}:"

# We have recipes-* directories, add to BBFILES
BBFILES += "${LAYERDIR}/recipes-*/*/*.bb \
            ${LAYERDIR}/recipes-*/*/*.bbappend"

BBFILES_DYNAMIC += " \
    rcar-gen3:${LAYERDIR}/dynamic-layers/meta-rcar-gen3-guest/*/*/*.bb \
    rcar-gen3:${LAYERDIR}/dynamic-layers/meta-rcar-gen3-guest/*/*/*.bbappend \
"

BBFILE_COLLECTIONS += "container-bsp-guest"
BBFILE_PATTERN_container-bsp-guest = "^${LAYERDIR}/"
BBFILE_PRIORITY_container-bsp-guest = "40"
LAYERSERIES_COMPAT_container-bsp-guest = "dunfell"
```

## meta-container-bsp-host/conf/layer.conf
```bitbake
# We have a conf and classes directory, add to BBPATH
BBPATH =. "${LAYERDIR}:"

# We have recipes-* directories, add to BBFILES
BBFILES += "${LAYERDIR}/recipes-*/*/*.bb \
            ${LAYERDIR}/recipes-*/*/*.bbappend"

BBFILES_DYNAMIC += " \
    rcar-gen3:${LAYERDIR}/dynamic-layers/meta-rcar-gen3-host/*/*/*.bb \
    rcar-gen3:${LAYERDIR}/dynamic-layers/meta-rcar-gen3-host/*/*/*.bbappend \
"

BBFILE_COLLECTIONS += "container-bsp-host"
BBFILE_PATTERN_container-bsp-host = "^${LAYERDIR}/"
BBFILE_PRIORITY_container-bsp-host = "40"
LAYERSERIES_COMPAT_container-bsp-host = "dunfell"
```
